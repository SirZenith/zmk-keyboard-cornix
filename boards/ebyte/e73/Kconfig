## boards/ebyte/e73/Kconfig
```kconfig
config ENABLE_DCDC
    bool "Enable DCDC mode"
    select SOC_DCDC_NRF52X
    default n
    depends on BOARD_E73 && SOC_SERIES_NRF52X

config ENABLE_CHARGER
    bool "Enable battery charger"
    default y
    depends on BOARD_E73
```

## boards/ebyte/e73/Kconfig.e73
```kconfig
config BOARD_E73
    select SOC_SERIES_NRF52X
    select SOC_NRF52840_QIAA
    imply RETAINED_MEM
    imply RETENTION
    imply RETENTION_BOOT_MODE
```

## boards/ebyte/e73/board.yml
```yaml
boards:
  - name: e73
    vendor: ebyte
    revision:
      format: major.minor.patch
      default: 1.0.0
      revisions:
        - name: 1.0.0
```

## boards/shields/cornix/Kconfig.defconfig
```kconfig
if SHIELD_CORNIX_LEFT_CENTRAL

config ZMK_KEYBOARD_NAME
    default "Cornix"

config ZMK_SPLIT_ROLE_CENTRAL
    default y

config ZMK_SPLIT_BLE_ROLE_CENTRAL
    default y

config ZMK_SPLIT_BLE_CENTRAL_BATTERY_LEVEL_FETCHING
    default y

config ZMK_SPLIT_BLE_CENTRAL_BATTERY_LEVEL_PROXY
    default y

if USB

config USB_NRFX
    default y

config USB_DEVICE_STACK
    default y

endif # USB

endif # SHIELD_CORNIX_LEFT_CENTRAL

## Peripheral device (right side)
if SHIELD_CORNIX_RIGHT || SHIELD_CORNIX_LEFT_PERIPHERAL

config ZMK_SPLIT_ROLE_CENTRAL
    default n

config ZMK_SPLIT_BLE_ROLE_CENTRAL
	default n

# Add keyboard debouncing
config ZMK_KSCAN_DEBOUNCE_PRESS_MS
    default 3
config ZMK_KSCAN_DEBOUNCE_RELEASE_MS
    default 3

endif # SHIELD_CORNIX_RIGHT

# Common options for both sides
if SHIELD_CORNIX_LEFT_CENTRAL  || SHIELD_CORNIX_LEFT_PERIPHERAL || SHIELD_CORNIX_RIGHT

#config BT_CTLR
#    default BT

config ZMK_SPLIT
    default y

config ZMK_BLE
    default y

# disable rgb by default
config ZMK_RGB_UNDERGLOW
    default n
config ZMK_RGB_UNDERGLOW_EXT_POWER
    default n

config ZMK_SLEEP
    default y
config ZMK_IDLE_SLEEP_TIMEOUT
    default 3600000

endif
```

## boards/shields/cornix/Kconfig.shield
```kconfig
config SHIELD_CORNIX_LEFT_CENTRAL
    def_bool $(shields_list_contains,cornix_left_central)

config SHIELD_CORNIX_LEFT_PERIPHERAL
    def_bool $(shields_list_contains,cornix_left_peripheral)

config SHIELD_CORNIX_RIGHT
    def_bool $(shields_list_contains,cornix_right)
```

## boards/shields/cornix_dongle/Kconfig.defconfig
```kconfig
if SHIELD_CORNIX_DONGLE

config ZMK_KEYBOARD_NAME
    default "Cornix Dongle"

config ZMK_SPLIT_ROLE_CENTRAL
    default y

config ZMK_SPLIT_BLE_ROLE_CENTRAL
    default y

config ZMK_SPLIT
    default y

config ZMK_BLE
    default y

if ZMK_DISPLAY

config I2C
    default y

endif # ZMK_DISPLAY

if LVGL

config LV_Z_VDB_SIZE
    default 64

config LV_DPI_DEF
    default 148

config LV_Z_BITS_PER_PIXEL
    default 1

choice LV_COLOR_DEPTH
    default LV_COLOR_DEPTH_1
endchoice

endif # LVGL

endif # SHIELD_CORNIX_DONGLE
```

## boards/shields/cornix_dongle_adapter/Kconfig.defconfig
```kconfig
if SHIELD_CORNIX_DONGLE_ADAPTER

config ZMK_KEYBOARD_NAME
    default "Cornix Dongle"

config ZMK_SPLIT_ROLE_CENTRAL
    default y

config ZMK_SPLIT_BLE_ROLE_CENTRAL
	default y

config ZMK_SPLIT
    default y

config ZMK_BLE
    default y

endif # END ALL

#vim: set ft=kconfig:
```

## boards/shields/cornix_led_widget/Kconfig.shield
```kconfig
config SHIELD_CORNIX_LED_WIDGET
    def_bool $(shields_list_contains,cornix_led_widget)

# Color definitions to use with color settings
COLOR_BLACK   := 0
COLOR_RED     := 1
COLOR_GREEN   := 2
COLOR_YELLOW  := 3
COLOR_BLUE    := 4
COLOR_MAGENTA := 5
COLOR_CYAN    := 6
COLOR_WHITE   := 7

config LED_WIDGET
    bool "Enable RGB LED widget for showing battery and output status"

if LED_WIDGET

config LED_WIDGET_LED_COUNT
    int "Number of LEDs in the strip"
    range 1 4
    default 2
    help
      Number of addressable LEDs in the WS2812 strip. Maximum 4 LEDs
      are supported for optimal performance and memory usage.

config LED_WIDGET_BRIGHTNESS
    int "Default LED brightness (0-255)"
    range 0 255
    default 128
    help
      Default brightness level for WS2812 LEDs. Lower values reduce
      power consumption and eye strain.

config CHARGING_LED_INDEX
    int "LED index for charging status"
    default 0
    help
      Index of the LED used to indicate charging status. Set to -1 to disable.

endif # LED_WIDGET
```

## boards/shields/cornix_rgb_widget/Kconfig.shield
```kconfig
config SHIELD_CORNIX_RGB_WIDGET
    def_bool $(shields_list_contains,cornix_rgb_widget)

# Color definitions to use with color settings
COLOR_BLACK   := 0
COLOR_RED     := 1
COLOR_GREEN   := 2
COLOR_YELLOW  := 3
COLOR_BLUE    := 4
COLOR_MAGENTA := 5
COLOR_CYAN    := 6
COLOR_WHITE   := 7

config RGBLED_WIDGET
    bool "Enable RGB LED widget for showing battery and output status"

if RGBLED_WIDGET

config RGBLED_WIDGET_LED_COUNT
    int "Number of LEDs in the strip"
    range 1 4
    default 2
    help
      Number of addressable LEDs in the WS2812 strip. Maximum 4 LEDs
      are supported for optimal performance and memory usage.

config RGBLED_WIDGET_BRIGHTNESS
    int "Default LED brightness (0-255)"
    range 0 255
    default 128
    help
      Default brightness level for WS2812 LEDs. Lower values reduce
      power consumption and eye strain.

endif # RGBLED_WIDGET
```

## config/west.yml
```yaml
manifest:
  remotes:
    - name: zmkfirmware
      url-base: https://github.com/zmkfirmware
  projects:
    - name: zmk
      remote: zmkfirmware
      revision: main
      clone-depth: 1
      import:
        file: app/west.yml
    - name: zmk-dongle-display
      url: https://github.com/englmaxi/zmk-dongle-display
      revision: main
  self:
    path: config
```
